## main/Kconfig.projbuild
```kconfig
menu "Sendspin XIAO"

    config WIFI_SSID
        string "WiFi SSID"
        default "your-wifi-ssid"

    config WIFI_PASSWORD
        string "WiFi Password"
        default "your-wifi-password"

    config DEVICE_NAME
        string "Friendly device name"
        default "Sendspin XIAO Native"

    config SENDSPIN_PORT
        int "Sendspin WebSocket port"
        default 8928

    config SENDSPIN_PATH
        string "Sendspin WebSocket path"
        default "/sendspin"

    config I2S_LRCK_GPIO
        int "I2S LRCK (word select) GPIO"
        default 4

    config I2S_BCK_GPIO
        int "I2S BCK (bit clock) GPIO"
        default 5

    config I2S_DOUT_GPIO
        int "I2S DOUT (data out) GPIO"
        default 6

    config PCM_XSMT_GPIO
        int "PCM5102A XSMT (soft-mute) GPIO (-1 to disable, leaves XSMT jumper bridged)"
        default 7
        help
            Drives the PCM5102A's XSMT pin. Driven LOW = analog output muted
            (silences the chip's idle hiss); HIGH = unmuted.
            Requires lifting the H3L solder jumper on the DAC breakout and
            wiring XSMT to this GPIO. Set to -1 to disable the firmware mute
            and rely on the H3L jumper holding XSMT high permanently.

    config STATUS_LED_GPIO
        int "Status LED GPIO (-1 to disable)"
        default 21

    config STATUS_LED_ACTIVE_LOW
        bool "Status LED is active-low (XIAO onboard LED is)"
        default y

    config OTA_PORT
        int "OTA HTTP server port"
        default 8080

    config OTA_TOKEN
        string "OTA bearer token (leave empty for no auth — fine on a trusted home network)"
        default ""
        help
            If empty: OTA pushes are accepted from anyone on the local network.
            If set: push tools must send this in the Authorization: Bearer <token> header.
            For shared/public networks, set a long random string here.

endmenu
```

## sdkconfig.defaults
```kconfig
CONFIG_IDF_TARGET="esp32s3"

CONFIG_SPIRAM=y
CONFIG_SPIRAM_MODE_OCT=y
CONFIG_SPIRAM_SPEED_80M=y
CONFIG_SPIRAM_USE_MALLOC=y
CONFIG_SPIRAM_TRY_ALLOCATE_WIFI_LWIP=y

CONFIG_ESP32S3_DEFAULT_CPU_FREQ_240=y

CONFIG_PARTITION_TABLE_CUSTOM=y
CONFIG_PARTITION_TABLE_CUSTOM_FILENAME="partitions.csv"

CONFIG_ESPTOOLPY_FLASHSIZE_8MB=y
CONFIG_ESPTOOLPY_FLASHSIZE="8MB"

CONFIG_COMPILER_OPTIMIZATION_PERF=y

CONFIG_FREERTOS_HZ=1000

CONFIG_LWIP_MAX_SOCKETS=16

CONFIG_LWIP_TCP_SND_BUF_DEFAULT=65535
CONFIG_LWIP_TCP_RCV_BUF_DEFAULT=65535
CONFIG_LWIP_TCP_WND_DEFAULT=65535
CONFIG_LWIP_TCP_MSS=1440
CONFIG_LWIP_TCP_RECVMBOX_SIZE=64
CONFIG_LWIP_UDP_RECVMBOX_SIZE=64
CONFIG_LWIP_TCPIP_RECVMBOX_SIZE=64

CONFIG_ESP_WIFI_STATIC_RX_BUFFER_NUM=16
CONFIG_ESP_WIFI_DYNAMIC_RX_BUFFER_NUM=64
CONFIG_ESP_WIFI_DYNAMIC_TX_BUFFER_NUM=64
CONFIG_ESP_WIFI_TX_BA_WIN=32
CONFIG_ESP_WIFI_RX_BA_WIN=32
CONFIG_ESP_WIFI_IRAM_OPT=y
CONFIG_ESP_WIFI_RX_IRAM_OPT=y
CONFIG_ESP_WIFI_AMPDU_TX_ENABLED=y
CONFIG_ESP_WIFI_AMPDU_RX_ENABLED=y

CONFIG_MBEDTLS_CMAC_C=y

CONFIG_ESP_MAIN_TASK_STACK_SIZE=8192

CONFIG_LOG_DEFAULT_LEVEL_INFO=y

# sendspin-cpp role selection — must be set before Component Manager resolves
# optional deps (micro-flac/micro-opus) on a fresh build with no sdkconfig.
CONFIG_SENDSPIN_ENABLE_PLAYER=y
CONFIG_SENDSPIN_ENABLE_CONTROLLER=y
CONFIG_SENDSPIN_ENABLE_METADATA=y
CONFIG_SENDSPIN_ENABLE_ARTWORK=n
CONFIG_SENDSPIN_ENABLE_VISUALIZER=n
```
